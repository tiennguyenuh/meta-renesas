## meta-rzg1/conf/machine/include/rzg1-common.inc
```bitbake
# Configuration for kernel
PREFERRED_PROVIDER_virtual/kernel = "linux-renesas"

MACHINEOVERRIDES =. "rzg1:"
MACHINE_FEATURES = "opengles"

KERNEL_IMAGETYPE = "uImage"
KERNEL_EXTRA_ARGS += "LOADADDR=0x40008000"

IMAGE_FSTYPES:append = " tar.bz2 ext4"

# Add variable to Build Configuration in build log
BUILDCFG_VARS:append = " SOC_FAMILY"

#add u-boot
PREFERRED_VERSION_u-boot = "v2013.01.01%"
EXTRA_IMAGEDEPENDS += " u-boot"

# We must disable ptest when can not use GPLv3 License,
# ptest require many package, which have GPLv3 License,
DISTRO_FEATURES:remove += "${@bb.utils.contains("INCOMPATIBLE_LICENSE", "GPLv3", "ptest", "",d)}"

# Match version between native and target sysroot in meta-gplv2 when not using GPLv3.
PREFERRED_VERSION_gdbm-native ?= "${@bb.utils.contains("INCOMPATIBLE_LICENSE", "GPLv3", "1.8.3", "",d)}"

BBMASK:append = " optee-client trusted-firmware-a optee-test"
IMAGE_INSTALL:remove += "optee-client"

# Avoid using these recipes in meta-rz-common, use rzg1 recipes instead
BBMASK:append = " meta-rz-common/recipes-multimedia/mmngr-module meta-rz-common/recipes-multimedia/vspmif-module"
BBMASK:append = " meta-rz-common/recipes-kernel/kernel-module-mmngr meta-rz-common/recipes-kernel/kernel-module-vspm meta-rz-common/recipes-kernel/kernel-module-vspmif"
```

## meta-rzg2h/conf/machine/include/rzg2h-common.inc
```bitbake
require conf/machine/include/rzg2-common.inc
require include/ecc-control.inc

# Configuration for ARM Trusted Firmware
EXTRA_IMAGEDEPENDS += " optee-os"

MACHINEOVERRIDES =. "rzg2h:"

MACHINE_FEATURES:append = " opengles hwh264dec hwh264enc hwh265dec "
```

## meta-rzg2l/conf/machine/include/tune-cortexa55.inc
```bitbake
DEFAULTTUNE ?= "cortexa55"

TUNEVALID[cortexa55] = "Enable Cortex-A55 specific processor optimizations"
TUNE_CCARGS .= "${@bb.utils.contains('TUNE_FEATURES', 'cortexa55', ' -mtune=cortex-a55', '', d)}"

require conf/machine/include/arm/arch-armv8-2a.inc

# Little Endian base configs
AVAILTUNES += "cortexa55"
ARMPKGARCH:tune-cortexa55             = "cortexa55"
TUNE_FEATURES:tune-cortexa55          = "${TUNE_FEATURES:tune-aarch64} cortexa55"
PACKAGE_EXTRA_ARCHS:tune-cortexa55    = "${PACKAGE_EXTRA_ARCHS:tune-aarch64} cortexa55"
BASE_LIB:tune-cortexa55               = "lib64"
```
